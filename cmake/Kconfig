## cmake/rt/rt1060/Kconfig.defconfig
```kconfig
# Copyright 2024 NXP
# SPDX-License-Identifier: BSD-3-Clause

# The purpose of this file is to redefine default values of configurations used when building Matter applications.
# This file only changes defaults, so all symbols here must be promptless.

if CHIP_NXP_PLATFORM_RT1060

# Add SDK dependencies required for RT1060
config CHIP_SDK_DEPENDENCIES
	select MCUX_COMPONENT_middleware.wireless.framework.platform.coex
	select MCUX_COMPONENT_middleware.wireless.framework.factory_data_provider if CHIP_FACTORY_DATA
	select MCUX_COMPONENT_middleware.wireless.framework.ota_support if CHIP_OTA_REQUESTOR
	
choice CHIP_NVM_COMPONENT
	default CHIP_NVM_COMPONENT_LITTLEFS
endchoice

# SDK defaults

# Wifi
choice MCUX_COMPONENT_middleware.wifi.wifidriver.selection
	default MCUX_DEPENDENCY_COMPONENT_middleware.wifi.wifidriver_DEPEND_ANYOF_OPTION_1
endchoice

# sdmmc
choice MCUX_COMPONENT_middleware.sdmmc.host.usdhc.selection
	default MCUX_COMPONENT_middleware.sdmmc.host.usdhc.non_blocking
endchoice

# FreeRTOS
choice MCUX_MISC_middleware.freertos-kernel.dynamic_allocator.selection
	default MCUX_COMPONENT_middleware.freertos-kernel.heap_4
endchoice

# Framework defaults
choice MCUX_COMPONENT_middleware.wireless.framework.platform.coex.transceiver
    default MCUX_COMPONENT_middleware.wireless.framework.platform.coex.iw612
endchoice

endif # CHIP_NXP_PLATFORM_RT1060
```

## cmake/rt/rt1170/Kconfig.defconfig
```kconfig
# Copyright 2024-2025 NXP
# SPDX-License-Identifier: BSD-3-Clause

# The purpose of this file is to redefine default values of configurations used when building Matter applications.
# This file only changes defaults, so all symbols here must be promptless.

if CHIP_NXP_PLATFORM_RT1170

config CHIP_SDK_DEPENDENCIES
	select MCUX_COMPONENT_driver.lpuart_edma
	select MCUX_COMPONENT_component.igpio_adapter

# SDK defaults
# Wifi
choice MCUX_COMPONENT_middleware.wifi.wifidriver.selection
	default MCUX_DEPENDENCY_COMPONENT_middleware.wifi.wifidriver_DEPEND_ANYOF_OPTION_1
endchoice

# sdmmc
choice MCUX_COMPONENT_middleware.sdmmc.host.usdhc.selection
	default MCUX_COMPONENT_middleware.sdmmc.host.usdhc.non_blocking
endchoice

# FreeRTOS
choice MCUX_MISC_middleware.freertos-kernel.dynamic_allocator.selection
	default MCUX_COMPONENT_middleware.freertos-kernel.heap_4
endchoice

#IW612 transceiver module type
if MCUX_COMPONENT_component.wifi_bt_module.IW61X
choice IW61X_MDOULE
	default MCUX_COMPONENT_component.wifi_bt_module.board_murata_2el_usd
endchoice
endif

endif # CHIP_NXP_PLATFORM_RT1170
```

## cmake/rt/rw61x/Kconfig.defconfig
```kconfig
# Copyright 2024-2025 NXP
# SPDX-License-Identifier: BSD-3-Clause

# The purpose of this file is to redefine default values of configurations used when building Matter applications.
# This file only changes defaults, so all symbols here must be promptless.

if CHIP_NXP_PLATFORM_RW61X

# Add SDK dependencies required for RW61x
config CHIP_SDK_DEPENDENCIES
    select MCUX_COMPONENT_driver.conn_fwloader
    imply MCUX_COMPONENT_component.mflash_offchip
    select MCUX_COMPONENT_middleware.freertos-kernel.cm33_non_trustzone
    select MCUX_COMPONENT_middleware.mbedtls.els_pkc.config
    select MCUX_COMPONENT_middleware.wifi.imu if CHIP_WIFI

# SDK defaults

choice MCUX_DEPENDENCY_COMPONENT_component.serial_manager_uart_DEPEND_COMPONENT_driver.selection
	default MCUX_DEPENDENCY_COMPONENT_component.serial_manager_uart_DEPEND_COMPONENT_driver.flexcomm_usart
endchoice

choice MCUX_COMPONENT_middleware.mbedtls.port.selection
	default MCUX_COMPONENT_middleware.mbedtls.port.els_pkc
endchoice

choice MCUX_COMPONENT_middleware.wifi.wifidriver.selection
	default MCUX_DEPENDENCY_COMPONENT_middleware.wifi.wifidriver_DEPEND_ANYOF_OPTION_2
endchoice

choice MCUX_DEPENDENCY_COMPONENT_component.timer_manager_DEPEND_component.timer.selection
	default MCUX_DEPENDENCY_COMPONENT_component.timer_manager_DEPEND_component.timer_manager_mrt
endchoice

# FreeRTOS
choice MCUX_MISC_middleware.freertos-kernel.dynamic_allocator.selection
	default MCUX_COMPONENT_middleware.freertos-kernel.heap_4
endchoice

config MCUX_COMPONENT_middleware.freertos-kernel.cm33_non_trustzone
    bool
    default y

# Monolithic configs
config MCUX_COMPONENT_driver.conn_fwloader.monolithic
	default y

config MONOLITHIC_WIFI
	default y if CHIP_WIFI

config MONOLITHIC_BLE
	default y if !NET_L2_OPENTHREAD

config MONOLITHIC_BLE_15_4
	default y if NET_L2_OPENTHREAD

# Framework defaults
config gPlatformMonolithicApp_d
	bool
	default y

if CHIP_WIFI

config WIFI_BOARD_RW610
	bool
	default y
	help
		No prefix in generated macro

endif

endif # CHIP_NXP_PLATFORM_RW61X
```

## github_sdk/common_sdk/manifest/west.yml
```yaml
# The west manifest file (west.yml) for MCUXpresso SDK delivery.
#
# See the west documentation for more information:
#
# https://docs.zephyrproject.org/latest/guides/west/index.html
manifest:
  projects:
    - name: sdk-release
      url: https://github.com/nxp-mcuxpresso/mcux-sdk.git
      revision: MCUX_2.16.100_QP2
      path: core
      import:
        name-allowlist:
          - mcux-sdk
          - FreeRTOS-Kernel
          - CMSIS_5
          - mcux-sdk-middleware-sdmmc
          - fatfs
          - mcux-sdk-middleware-edgefast-bluetooth
          - mcux-sdk-middleware-ethermind
          - mcux-sdk-middleware-connectivity-framework
          - mbedtls
          - lwip
          - littlefs
          - mcuboot
          - mcux-sdk-middleware-bluetooth-controller
          - mcux-sdk-middleware-bluetooth-host
          - mcux-sdk-middleware-ieee_802.15.4
          - mcux-sdk-middleware-multicore
          - mcux-sdk-middleware-usb
          - rpmsg-lite
          - mcux-secure-subsystem
          - wifi_nxp
        path-prefix: repo
    - name: mcux-sdk-examples
      url: https://github.com/nxp-mcuxpresso/mcux-sdk-examples.git
      revision: MCUX_2.16.100
      path: repo/examples
      groups:
        - groupSdkExample
  group-filter: [-groupSdkExample]
```

## github_sdk/k32w0/manifest/west.yml
```yaml
# The west manifest file (west.yml) for MCUXpresso SDK delivery.
#
# See the west documentation for more information:
#
# https://docs.zephyrproject.org/latest/guides/west/index.html
manifest:
  projects:
    - name: mcux-sdk-k32w0-2.6.15
      url: https://github.com/nxp-mcuxpresso/mcux-sdk.git
      revision: MCUX_2.6.15_K32W0
      path: core
      import:
        file: west.yml
        name-allowlist:
          - mcux-sdk
          - mcux-sdk-examples
          - mcux-sdk-middleware-connectivity-framework
          - mcux-sdk-middleware-bluetooth-controller
          - mcux-sdk-middleware-bluetooth-host
          - mcux-sdk-middleware-ieee_802.15.4
          - mbedtls
          - amazon-freertos
        path-prefix: repo
```
