## cmake/Kconfig
```kconfig
# Copyright 2024 NXP
# SPDX-License-Identifier: BSD-3-Clause

# The purpose of this file is to define common Kconfig for application configurations.

if CHIP

# Include SDK dependencies Kconfig
rsource "Kconfig.sdk.common"

config MATTER_APP_DEFAULT_BOARD_FILES
    bool "Use default board files"
    default y
    help
        If enabled, the default board files under "examples/platform" will be used.

config REMOVE_SECTIONS_FROM_BIN
	string "Sections to remove from the generated binary"
	default "-R .NVM"
	help
		Define sections to remove from the generated binary of the application.

config BOOTLOADER_MCUBOOT
	bool "MCUBoot bootloader"
	help
		Use MCUBoot as the bootloader of the application.

if BOOTLOADER_MCUBOOT

config CHIP_MCUBOOT_SLOT_SIZE
	hex "Slot size"
	default 0x440000
	help
		The application slot size to communicate to the MCUBoot.

config CHIP_MCUBOOT_MAX_SECTORS
	int "Application max sectors"
	default 1088
	help
		The maximum number of sectors comprised in the application slot.

config CHIP_MCUBOOT_HEADER_SIZE
	hex "Application header size"
	default 0x1000
	help
		The header size of the application.

endif # BOOTLOADER_MCUBOOT

config BUILD_K32W0_OT_RCP_IMAGE
	bool "k32w0 rcp ot ble hci bb single uart image build"
	default y if MCUX_COMPONENT_component.wifi_bt_module.K32W061_transceiver
	default n
	help
		Enable k32w0 rcp ot ble hci bb single uart image build.

endif # CHIP
```

## cmake/Kconfig.defconfig
```kconfig
# Copyright 2024 NXP
# SPDX-License-Identifier: BSD-3-Clause

# The purpose of this file is to redefine default values of configurations used when building Matter applications.
# This file only changes defaults, so all symbols here must be promptless.
# This file is common to all NXP platforms.

rsource "*/Kconfig.defconfig"

# Here we disable default board files provided by SDK
# in order to use app customized board files
config MCUX_PRJSEG_module.board.use_board_clock
    bool
    default n

config MCUX_HAS_PRJSEG_module.board.pinmux_sel
    bool
    default n

choice MCUX_PRJSEG_module.board.pinmux_sel
    default MCUX_PRJSEG_module.board.pinmux_customize_folder
endchoice

config MCUX_HAS_PRJSEG_project.use_hw_app
    bool
    default n

choice MCUX_PRJSEG_project.hw_app_sel
    default MCUX_PRJSEG_project.hw_app_customize_folder
endchoice
```

## cmake/Kconfig.sdk.common
```kconfig
# Copyright 2024-2025 NXP
# SPDX-License-Identifier: BSD-3-Clause

# The purpose of this file is to define NXP SDK dependencies required for Matter.

if CHIP

config CHIP_SDK_DEPENDENCIES
	bool "Platform SDK dependencies for Matter protocol stack"
	select MCUX_COMPONENT_component.osa
	select MCUX_COMPONENT_component.osa_interface
	select MCUX_COMPONENT_component.flash_adapter
	select MCUX_COMPONENT_component.serial_manager
	select MCUX_COMPONENT_component.serial_manager_uart
	select MCUX_COMPONENT_component.software_rng_adapter
	select MCUX_COMPONENT_middleware.freertos-kernel
	select MCUX_COMPONENT_middleware.wireless.framework
	select MCUX_COMPONENT_middleware.wireless.framework.function_lib
	select NVS if CHIP_NVM_COMPONENT_NVS
	select SETTINGS if CHIP_NVM_COMPONENT_NVS
	select SETTINGS_RUNTIME if CHIP_NVM_COMPONENT_NVS
	select MCUX_COMPONENT_middleware.wireless.framework.zephyr_port.nvs.stats if CHIP_NVM_COMPONENT_NVS
	select MCUX_COMPONENT_middleware.wireless.framework.file_system if CHIP_NVM_COMPONENT_LITTLEFS
	select MCUX_COMPONENT_middleware.littlefs if CHIP_NVM_COMPONENT_LITTLEFS
	select MCUX_COMPONENT_middleware.wireless.framework.platform.ot if NET_L2_OPENTHREAD
	select CHIP_SDK_DEPENDENCIES_WIFI if CHIP_WIFI
	select CHIP_SDK_DEPENDENCIES_BLE if CHIP_DEVICE_USE_ZEPHYR_BLE
	help
		Enables the NXP SDK dependencies required for the Matter protocol stack to work.

if CHIP_SDK_DEPENDENCIES

config CHIP_SDK_DEPENDENCIES_WIFI
	bool "SDK dependencies for Matter-over-WiFi protocol stack"
	select MCUX_COMPONENT_middleware.wifi
	select MCUX_COMPONENT_middleware.wifi.wifidriver
	select MCUX_COMPONENT_middleware.wifi.net_free_rtos
	select MCUX_COMPONENT_component.wifi_bt_module.tx_pwr_limits
	help
		Enable SDK components required for NXP Wi-Fi support.

config CHIP_SDK_DEPENDENCIES_BLE
	bool "SDK dependencies for BLE"
	select MCUX_COMPONENT_middleware.edgefast_bluetooth.porting
	select MCUX_COMPONENT_middleware.edgefast_bluetooth.pal
	select MCUX_COMPONENT_middleware.edgefast_bluetooth.pal.platform.ethermind
	select MCUX_COMPONENT_middleware.edgefast_bluetooth.common.ethermind
	select MCUX_COMPONENT_middleware.wireless.framework.platform.ble
	help
		Enable SDK components required for BLE support.

config CHIP_SDK_DEPENDENCIES_BLE_HOST
	bool "SDK dependencies for BLE host implementation"
	select MCUX_COMPONENT_middleware.wireless.ble_init_matter
	select MCUX_COMPONENT_middleware.wireless.ble_hci_transport_rpmsg
	select MCUX_COMPONENT_middleware.wireless.ble_host
	select MCUX_COMPONENT_middleware.wireless.ble_host_common
	select MCUX_COMPONENT_middleware.wireless.ble_host_peripheral_component_lib
	select MCUX_COMPONENT_middleware.wireless.ble_controller_interface
	select MCUX_COMPONENT_middleware.wireless.ble_gatt_db
	help
		Enable SDK components required for BLE host support.

endif # CHIP_SDK_DEPENDENCIES

endif # CHIP
```

## cmake/mcxw71_k32w1/Kconfig.defconfig
```kconfig
# Copyright 2024 NXP
# SPDX-License-Identifier: BSD-3-Clause

# The purpose of this file is to define new default values of settings used when building Matter samples.
# This file only changes defaults and thus all symbols here must be promptless
# and safeguarded so that they only are applied when building Matter.

if CHIP_NXP_PLATFORM_K32W1 || CHIP_NXP_PLATFORM_MCXW71 || CHIP_NXP_PLATFORM_MCXW72

config CHIP_SDK_DEPENDENCIES
    select CHIP_SDK_DEPENDENCIES_BLE_HOST if BT
    select MCUX_COMPONENT_component.button
    select MCUX_COMPONENT_component.flash_nor_lpspi
    select MCUX_COMPONENT_component.led
    select MCUX_COMPONENT_component.lptmr_adapter
    select MCUX_COMPONENT_component.lptmr_time_stamp_adapter
    select MCUX_COMPONENT_component.messaging
    select MCUX_COMPONENT_component.mflash_onchip
    select MCUX_COMPONENT_component.panic
    select MCUX_COMPONENT_component.power_manager_framework
    select MCUX_COMPONENT_component.reset_adapter
    select MCUX_COMPONENT_utility.assert
    select MCUX_COMPONENT_utility.debug_console
    select MCUX_COMPONENT_middleware.freertos-kernel.cm33_non_trustzone
    select MCUX_COMPONENT_middleware.wireless.framework.module_info
    select MCUX_COMPONENT_middleware.wireless.framework.seclib
    select MCUX_COMPONENT_middleware.wireless.framework.lowpower
    select MCUX_COMPONENT_middleware.wireless.ieee_802_15_4
    select MCUX_COMPONENT_middleware.mbedtls.port.sssapi_option

if NET_L2_OPENTHREAD

config MCUX_COMPONENT_middleware.wireless.framework.platform.ot
    default y

endif # NET_L2_OPENTHREAD

# SDK defaults

# Board config
config MCUX_PRJSEG_module.board.use_board_clock
    default n

choice MCUX_PRJSEG_module.board.clock_sel
    default MCUX_PRJSEG_module.board.clock_customize_folder
endchoice

config gMainThreadStackSize_c
	default 3096

# Button     
config BUTTON_SHORT_PRESS_THRESHOLD
    default "1500U"
        
config BUTTON_LONG_PRESS_THRESHOLD
    default "2500U"

# Debug console
config MCUX_PRJSEG_utility.debug_console_transfer_non_blocking
    default y

# FreeRTOS
config MCUX_PRJSEG_middleware.freertos-kernel.generated_config
    default n

# Framework defaults

config NVS_LOOKUP_CACHE
	default y

config NVS_LOOKUP_CACHE_SIZE
	default 1024

choice MCUX_COMPONENT_component.mem_manager_selection
    default MCUX_COMPONENT_component.mem_manager_light
endchoice

choice MCUX_DEPENDENCY_COMPONENT_utilityt.debug_console_selection
    default MCUX_DEPENDENCY_COMPONENT_utilityt.debug_console_free_rtos
endchoice

config MCUX_COMPONENT_middleware.wireless.controller_api
    default y

if MCUX_COMPONENT_middleware.wireless.framework.zephyr_port.nvs
choice MCUX_COMPONENT_middleware.wireless.framework.zephyr_port.nvs.flash_selection
    default MCUX_COMPONENT_middleware.wireless.framework.zephyr_port.nvs.internal_flash
endchoice
endif

choice MCUX_COMPONENT_middleware.wireless.framework.seclib_port
    prompt "SecLib port selection"
    default MCUX_COMPONENT_middleware.wireless.framework.seclib_port.secure_subsystem
endchoice

config MCUX_COMPONENT_middleware.wireless.framework.heap_mem_manager
    default y

config MCUX_COMPONENT_middleware.wireless.framework.platform.ble
    default y

choice MCUX_COMPONENT_middleware.wireless.ieee_802_15_4.options
    default MCUX_COMPONENT_middleware.wireless.ieee_802_15_4.split_PHY
endchoice

endif # if CHIP_NXP_PLATFORM_K32W1 || CHIP_NXP_PLATFORM_MCXW71 || CHIP_NXP_PLATFORM_MCXW72
```

## cmake/rt/Kconfig.defconfig
```kconfig
# Copyright 2024-2025 NXP
# SPDX-License-Identifier: BSD-3-Clause

# The purpose of this file is to redefine default values of configurations used when building Matter applications.
# This file only changes defaults, so all symbols here must be promptless.
# This file is common to RT1060, RT1170, RW61X families.

if CHIP_NXP_PLATFORM_RW61X || CHIP_NXP_PLATFORM_RT1170 || CHIP_NXP_PLATFORM_RT1060

rsource "*/Kconfig.defconfig"

# Add SDK dependencies required for RT platforms
config CHIP_SDK_DEPENDENCIES
	select MCUX_COMPONENT_utility.debug_console_lite
	select MCUX_COMPONENT_middleware.wireless.framework.factory_data_provider if CHIP_FACTORY_DATA
	select MCUX_COMPONENT_middleware.wireless.framework.ota_support if CHIP_OTA_REQUESTOR
	select MCUX_COMPONENT_middleware.lwip
	select MCUX_COMPONENT_component.lpspi_adapter if OT_NXP_SPINEL_INTERFACE_LINK="spi"
	select MCUX_COMPONENT_middleware.wireless.framework.platform.hdlc if OT_NXP_SPINEL_INTERFACE_LINK="hci_spinel_single_uart" || OT_NXP_SPINEL_INTERFACE_LINK="hdlc"
	select MCUX_COMPONENT_middleware.wifi.osa_free_rtos
	select MCUX_COMPONENT_component.wifi_bt_module.config
	select MCUX_COMPONENT_middleware.mbedtls
	select MCUX_COMPONENT_component.button if CHIP_APP_BUTTON

config CHIP_SDK_DEPENDENCIES_ETHERNET
	bool "SDK ethernet dependencies"
    select MCUX_COMPONENT_driver.enet if CHIP_ETHERNET
	select MCUX_COMPONENT_middleware.lwip.kinetis_ethernetif if CHIP_ETHERNET
	select MCUX_COMPONENT_component.silicon_id if CHIP_ETHERNET

if MCUX_COMPONENT_middleware.wireless.framework.ota_support
choice MCUX_COMPONENT_middleware.wireless.framework.ota_support.flash_selection
	default MCUX_COMPONENT_middleware.wireless.framework.ota_support.external_flash
endchoice
endif # MCUX_COMPONENT_middleware.wireless.framework.ota_support

config SERIAL_MANAGER_NON_BLOCKING_MODE
	default y

config BUTTON_SHORT_PRESS_THRESHOLD
	default "500U"

config BUTTON_LONG_PRESS_THRESHOLD
	default "2000U"

config SERIAL_MANAGER_TASK_STACK_SIZE
	default "4048U"

config SERIAL_MANAGER_TASK_HANDLE_RX_AVAILABLE_NOTIFY
	bool
	default y

config SERIAL_MANAGER_RING_BUFFER_FLOWCONTROL
	bool
	default y

config gMainThreadStackSize_c
	default 4096

config FSL_OSA_ALLOCATED_HEAP
	default n

config FSL_OSA_MAIN_FUNC_ENABLE
	default n

# FreeRTOS defaults
config configTICK_RATE_HZ
	default 1000

config configMAX_PRIORITIES
	default 10

config configRUN_FREERTOS_SECURE_ONLY
	default y

config configTIMER_QUEUE_LENGTH
	default 10

config configUSE_IDLE_HOOK
	default y

config configAPPLICATION_ALLOCATED_HEAP
	default y

config configCHECK_FOR_STACK_OVERFLOW
	default y

config configTIMER_TASK_PRIORITY
	default "(configMAX_PRIORITIES - 3)"

config configTOTAL_HEAP_SIZE
	default 174080 if CHIP_WIFI && NET_L2_OPENTHREAD
	default 129024

config configMINIMAL_STACK_SIZE
	default 2048

# This Kconfig requires quotes "" due to its definition as a string
config configTIMER_TASK_STACK_DEPTH
	default "2048"

config configRECORD_STACK_HIGH_ADDRESS
	default y

config configINCLUDE_FREERTOS_TASK_C_ADDITIONS_H
	default y

config configUSE_TICK_HOOK
	default y if CHIP_WIFI

config configENABLE_FPU
	default y

config configMAX_TASK_NAME_LEN
	default 16

config configSUPPORT_STATIC_ALLOCATION
	default y

config configNUM_THREAD_LOCAL_STORAGE_POINTERS
	default 0

config configSTACK_DEPTH_TYPE
	default "StackType_t"

config INCLUDE_uxTaskGetStackHighWaterMark2
	default n

config INCLUDE_xTaskGetIdleTaskHandle
	default n

config INCLUDE_eTaskGetState
	default n

config INCLUDE_xTaskGetHandle
	default n

config configKERNEL_PROVIDED_STATIC_MEMORY
	default y

# BLE defaults
if BT 

# Use debug console lite / assert lite in edgefast_bluetooth porting component
choice MCUX_COMPONENT_middleware.edgefast_bluetooth.porting_debug_console_selection
	default MCUX_COMPONENT_middleware.edgefast_bluetooth.porting_DEPEND_ANYOF_OPTION_2
endchoice

config BT_DEVICE_NAME_GATT_WRITABLE
	bool
	default y

config DEVICE_NAME_GATT_WRITABLE_ENCRYPT
	bool
	default y

config BT_DEVICE_NAME_DYNAMIC
	bool
	default y

config BT_MAX_CONN
	default 1

config BT_PERIPHERAL
	bool
	default y

config BT_GATT_DYNAMIC_DB
	bool
	default y

config MCUX_PRJSEG_middleware.edgefast_bluetooth.storage
	bool
	default n

config USB_DISK_ENABLE
	bool
	default n

config USB_HOST_CONFIG_MSD
	default 1

config BT_HOST_CRYPTO
	bool 
	default y

config BT_KEYS_OVERWRITE_OLDEST
	bool
	default y

config BT_BUF_ACL_RX_SIZE
	default 251

config BT_L2CAP_TX_MTU
	default 247

config USB_HOST_CONFIG_EHCI
	default 2

config CONTROLLER_ID
	default 2U

config BT_DEVICE_NAME
	default "\"NXP BLE test\""

config BT_BLE_PLATFORM_INIT_ESCAPE
	default y

endif # BT

if CHIP_WIFI

config MCUX_COMPONENT_middleware.wifi.wifidriver.softap
	bool
	default n

config MCUX_COMPONENT_middleware.wifi.net_free_rtos.iperf
	default n

endif # CHIP_WIFI

# NVS defaults
config NVS_LOOKUP_CACHE
	default y

config NVS_LOOKUP_CACHE_SIZE
	default 1024

config SETTINGS_NVS_SECTOR_SIZE_MULT
	default "(((4096U) * 2u) / (4096U))"

config SETTINGS_NVS_SECTOR_COUNT
	default "((uint32_t)NV_STORAGE_SIZE / ((4096U) * 2u))"

config MCUX_PRJSEG_middleware.fatfs.generated_config
    default n

config MCUX_COMPONENT_middleware.wireless.framework.platform.coex
	default n if MCUX_COMPONENT_component.wifi_bt_module.88W8801 || MCUX_COMPONENT_component.wifi_bt_module.IW416
	default y

if MCUX_COMPONENT_middleware.wireless.framework.platform.coex && MCUX_COMPONENT_middleware.wireless.framework.platform.imx_rt
choice MCUX_COMPONENT_middleware.wireless.framework.platform.coex.transceiver
	default MCUX_COMPONENT_middleware.wireless.framework.platform.coex.k32w0 if MCUX_COMPONENT_component.wifi_bt_module.K32W061_transceiver
	default MCUX_COMPONENT_middleware.wireless.framework.platform.coex.iw612 if MCUX_COMPONENT_component.wifi_bt_module.IW61X
endchoice
endif # MCUX_COMPONENT_middleware.wireless.framework.platform.coex && MCUX_COMPONENT_middleware.wireless.framework.platform.imx_rt

#IW416 transceiver module type
if MCUX_COMPONENT_component.wifi_bt_module.IW416
choice IW416_MDOULE
	default MCUX_COMPONENT_component.wifi_bt_module.board_aw_am510_usd
endchoice
endif

#8801 transceiver module type
if MCUX_COMPONENT_component.wifi_bt_module.88W8801
choice 88W8801_MODULE
	default MCUX_COMPONENT_component.wifi_bt_module.board_murata_2ds_usd
endchoice # 88W8801_MODULE
endif

config OT_NXP_SPINEL_INTERFACE_LINK
	default "hci_spinel_single_uart" if MCUX_COMPONENT_component.wifi_bt_module.K32W061_transceiver

endif # CHIP_NXP_PLATFORM_RW61X || CHIP_NXP_PLATFORM_RT1170 || CHIP_NXP_PLATFORM_RT1060
```
