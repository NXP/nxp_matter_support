## cmake/mcxw7x_sdk/Kconfig.defconfig
```kconfig
# Copyright 2024-2025 NXP
# SPDX-License-Identifier: BSD-3-Clause

# The purpose of this file is to define new default values of settings used when building Matter samples.
# This file only changes defaults and thus all symbols here must be promptless
# and safeguarded so that they only are applied when building Matter.

# Application features Configs - BLE CS

if CHIP_NXP_PLATFORM_MCXW72

config CHIP_SDK_DEPENDENCIES_BLE_HOST_CS
    select MCUX_COMPONENT_CMSIS_DSP_Include
    select MCUX_COMPONENT_CMSIS_DSP_Source
    select MCUX_COMPONENT_middleware.wireless.xcvr
    select MCUX_COMPONENT_middleware.wireless.xcvr.gen475

    select MCUX_COMPONENT_middleware.wireless.lcl
    select MCUX_COMPONENT_middleware.wireless.lcl_algo
    select MCUX_COMPONENT_middleware.wireless.ble_host_CS_component_lib
    select MCUX_COMPONENT_middleware.wireless.genfsk_wr_lcl_algo_cm33_lce_lib
    select MCUX_COMPONENT_middleware.wireless.ble_profiles_ranging_client
    select MCUX_COMPONENT_middleware.wireless.ble_profiles_ranging

    select MCUX_COMPONENT_middleware.wireless.ble_fsci_interface
    select MCUX_COMPONENT_middleware.wireless.ble_gatt_service_discovery
    select MCUX_COMPONENT_middleware.wireless.ble_host_OPT_component_lib
    select MCUX_COMPONENT_middleware.wireless.framework.platform.lcl
    select MCUX_COMPONENT_middleware.wireless.framework.sensors
    select MCUX_PRJSEG_module.board.wireless.app_lce
    select MCUX_COMPONENT_driver.ce
    select MCUX_COMPONENT_driver.mu1
    select MCUX_COMPONENT_component.lce

endif # if CHIP_NXP_PLATFORM_MCXW72

if CHIP_NXP_PLATFORM_MCXW71 || CHIP_NXP_PLATFORM_MCXW72

config CHIP_SDK_DEPENDENCIES
    select CHIP_SDK_DEPENDENCIES_BLE_HOST if BT
    select MCUX_COMPONENT_component.button
    select MCUX_COMPONENT_component.flash_nor_lpspi
    select MCUX_COMPONENT_component.led
    select MCUX_COMPONENT_component.lptmr_adapter
    select MCUX_COMPONENT_component.lptmr_time_stamp_adapter
    select MCUX_COMPONENT_component.messaging
    select MCUX_COMPONENT_component.mflash_onchip
    select MCUX_COMPONENT_component.panic
    select MCUX_COMPONENT_component.power_manager_framework
    select MCUX_COMPONENT_component.reset_adapter
    select MCUX_COMPONENT_utility.assert
    select MCUX_COMPONENT_utility.debug_console
    select MCUX_COMPONENT_middleware.freertos-kernel.cm33_non_trustzone
    select MCUX_COMPONENT_middleware.wireless.framework.module_info
    select MCUX_COMPONENT_middleware.wireless.framework.seclib
    select MCUX_COMPONENT_middleware.wireless.framework.lowpower
    select MCUX_COMPONENT_middleware.wireless.framework.platform.external_flash
    select MCUX_COMPONENT_middleware.wireless.ieee_802_15_4
    select MCUX_COMPONENT_component.psa_crypto_driver.ele_s200 if CHIP_NXP_PLATFORM_MCXW72 && CHIP_MBEDTLS_3X
    select MCUX_DEPENDENCY_COMPONENT_component.psa_crypto_driver.ele_s200.osal_frtos if CHIP_NXP_PLATFORM_MCXW72 && CHIP_MBEDTLS_3X
    select MCUX_COMPONENT_middleware.secure-subsystem.firmware if CHIP_NXP_PLATFORM_MCXW72 && CHIP_MBEDTLS_3X

# SDK defaults

# Board config
config MCUX_PRJSEG_module.board.use_board_clock
    default n

choice MCUX_PRJSEG_module.board.clock_sel
    default MCUX_PRJSEG_module.board.clock_customize_folder
endchoice

config gMainThreadStackSize_c
    default 9000 if CHIP_SE05X # SE05X requires additional stack for crypto operations
    default 6192 # Base stack size for standard operations

config gMainThreadPriority_c
    default 5

config ECC_RAM_STCM8_INIT
    default y if CHIP_NXP_PLATFORM_MCXW72

config FSL_OSA_MAIN_FUNC_ENABLE
    default y

config FSL_OSA_ALLOCATED_HEAP
    default n

config MCUX_PRJSEG_component.osa_interface.osa_macro_used
    default n if !NXP_USE_LOW_POWER

# Button     
config BUTTON_SHORT_PRESS_THRESHOLD
    default "200U"
        
config BUTTON_LONG_PRESS_THRESHOLD
    default "1200U"

config BUTTON_DOUBLE_CLICK_THRESHOLD
    default "500U"

# Debug console
config MCUX_PRJSEG_utility.debug_console_transfer_non_blocking
    default y

config SERIAL_MANAGER_NON_BLOCKING_MODE
    default y

config MCUX_PRJSEG_configure.timer_manager_enable_time_stamp
    default y

# FreeRTOS
config MCUX_PRJSEG_middleware.freertos-kernel.generated_config
    default n

# Framework defaults

config NVS_LOOKUP_CACHE
	default y

config NVS_LOOKUP_CACHE_SIZE
	default 1024

config SETTINGS_NVS_SECTOR_SIZE_MULT
	default "(((8192u) * 1u) / (8192u))"

config SETTINGS_NVS_SECTOR_COUNT
	default "((uint32_t)NV_STORAGE_SIZE / ((8192u) * 1u))"

choice MCUX_COMPONENT_component.mem_manager_selection
    default MCUX_COMPONENT_component.mem_manager_light
endchoice

choice MCUX_DEPENDENCY_COMPONENT_utility.debug_console_selection
    default MCUX_DEPENDENCY_COMPONENT_utility.debug_console_free_rtos
endchoice

if CHIP_MBEDTLS_2X
choice MCUX_COMPONENT_middleware.mbedtls.port.selection
    default MCUX_COMPONENT_middleware.mbedtls.port.sssapi
endchoice
endif

config MCUX_COMPONENT_middleware.wireless.controller_api
    default y

if MCUX_COMPONENT_middleware.wireless.framework.zephyr_port.nvs
choice MCUX_COMPONENT_middleware.wireless.framework.zephyr_port.nvs.flash_selection
    default MCUX_COMPONENT_middleware.wireless.framework.zephyr_port.nvs.internal_flash
endchoice
endif

if MCUX_COMPONENT_middleware.wireless.framework.ota_support
choice MCUX_COMPONENT_middleware.wireless.framework.ota_support.flash_selection
	default MCUX_COMPONENT_middleware.wireless.framework.ota_support.no_flash_selected
endchoice
endif # MCUX_COMPONENT_middleware.wireless.framework.ota_support

choice MCUX_COMPONENT_middleware.wireless.framework.seclib_rng_port
    default MCUX_COMPONENT_middleware.wireless.framework.seclib_rng_port.psa if CHIP_MBEDTLS_3X
    default MCUX_COMPONENT_middleware.wireless.framework.seclib_rng_port.secure_subsystem
endchoice

config MCUX_COMPONENT_middleware.wireless.framework.heap_mem_manager
    default y

config MCUX_COMPONENT_middleware.wireless.framework.platform.ble
    default y

choice MCUX_COMPONENT_middleware.wireless.ieee_802_15_4.selection
    default MCUX_COMPONENT_middleware.wireless.ieee_802_15_4.split_PHY
endchoice

# Multicore rpmsg

config MCUX_PRJSEG_middleware.multicore.rpmsg-lite.generated_config
    default n

if NXP_USE_LOW_POWER

config NXP_USE_POWER_DOWN
    default n
#   default y if CHIP_NXP_PLATFORM_MCXW72

if NXP_USE_POWER_DOWN

# Use a default value of 2 seconds for the PowerDown threshold as the DC-DC
# charge/discharge cycle kicks in around 1.6 seconds after falling asleep
config NXP_POWER_DOWN_POLL_THRESHOLD
    default 2

endif # NXP_USE_POWER_DOWN

endif # NXP_USE_LOW_POWER

endif # if CHIP_NXP_PLATFORM_MCXW71 || CHIP_NXP_PLATFORM_MCXW72
```

## github_sdk/sdk_next/manifest/west.yml
```yaml
# The west manifest file (west.yml) for MCUXpresso SDK delivery.
#
# See the west documentation for more information:
#
# https://docs.zephyrproject.org/latest/guides/west/index.html
manifest:
    projects:
        - name: mcuxsdk_manifest
          url: https://github.com/nxp-mcuxpresso/mcuxsdk-manifests
          revision: v26.06.00
          import:
              name-allowlist:
                  - mcux-sdk-middleware-connectivity-framework
                  - freertos-kernel
                  - freertos-kernel-upstream
                  - mcux-freertos-drivers
                  - mcux-devices-wireless
                  - CMSIS
                  - mcux-sdk-middleware-sdmmc
                  - fatfs
                  - ethermind
                  - littlefs
                  - ble_controller
                  - bluetooth
                  - edgefast_bt_ble
                  - ieee-802.15.4
                  - XCVR
                  - mcux-sdk-middleware-multicore
                  - usb
                  - rpmsg-lite
                  - secure-subsystem
                  - wifi_nxp
                  - wpa_supplicant-rtos
                  - els_pkc
                  - mcux-devices-rt
                  - mcux-devices-mcx
                  - mcux-mcmgr
                  - erpc
                  - mcuboot_opensource
                  - mcu-sdk-components
                  - secure_storage
                  - fw_bin
                  - mcuxsdk-tool-data
              path-prefix: repo
        - name: core
          url: https://github.com/nxp-mcuxpresso/mcuxsdk-core
          revision: 7599a858252dafa23467fd81eb172fb2395b35d1
          path: repo/mcuxsdk/
          west-commands: scripts/west_commands.yml
        - name: psa_crypto_driver
          url: https://github.com/NXP/psa_crypto_driver
          path: repo/mcuxsdk/components/psa_crypto_driver
          revision: 826a7cba1a90aab596b9d7fce5718d9c9611dabb
        - name: mcu-sdk-examples
          url: https://github.com/nxp-mcuxpresso/mcuxsdk-examples
          path: repo/mcuxsdk/examples
          revision: 1c5385819defc787e55b4e19a1c6ae0ac4900611
        - name: wifi_nxp
          url: https://github.com/NXP/wifi_nxp
          path: repo/mcuxsdk/middleware/wifi_nxp
          revision: 0036f351323f2446a6e6ce9cf4079862cb934d95
        - name: lwip
          url: https://github.com/nxp-mcuxpresso/lwip
          path: repo/mcuxsdk/middleware/lwip
          revision: a5bc68f1b34f3b407a71e588bbca46091fd506a3
        - name: mbedtls3x
          url: https://github.com/NXP/nxp_mbedtls
          path: repo/mcuxsdk/middleware/mbedtls3x
          revision: 8bfb34b095ded5a00e383a4c7064f793dd5d5dbf
        - name: bifrost
          url: https://github.com/nxp-zephyr/bifrost
          revision: main
          path: repo/bifrost
          groups:
              - bifrost
group-filter: [-bifrost]
```
